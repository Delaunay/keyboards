## split/v2/zmk/boards/shields/splitv2/Kconfig.defconfig
```kconfig
if SHIELD_SPLITV2_DONGLE

# Name must be 16 characters or fewer. The host sees the dongle.
config ZMK_KEYBOARD_NAME
    default "Split V2"

config ZMK_SPLIT_ROLE_CENTRAL
    default y

# Left and right halves.
config ZMK_SPLIT_BLE_CENTRAL_PERIPHERALS
    default 2

# Peripherals plus five Bluetooth profiles.
config BT_MAX_CONN
    default 7

config BT_MAX_PAIRED
    default 7

config ZMK_SPLIT_BLE_CENTRAL_BATTERY_LEVEL_FETCHING
    default y

config ZMK_SPLIT_BLE_CENTRAL_BATTERY_LEVEL_PROXY
    default y

endif

if SHIELD_SPLITV2_LEFT || SHIELD_SPLITV2_RIGHT || SHIELD_SPLITV2_DONGLE

config ZMK_SPLIT
    default y

endif
```
